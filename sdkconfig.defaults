## sdkconfig.defaults
```kconfig
# BT config - use NimBLE
CONFIG_BT_ENABLED=y
CONFIG_BT_NIMBLE_ENABLED=y
CONFIG_BTDM_CTRL_MODE_BLE_ONLY=y
CONFIG_BTDM_CTRL_MODE_BR_EDR_ONLY=n
CONFIG_BTDM_CTRL_MODE_BTDM=n
CONFIG_BT_BLUEDROID_ENABLED=n

# Central (client) role
CONFIG_BT_NIMBLE_ROLE_CENTRAL=y
CONFIG_BT_NIMBLE_ROLE_PERIPHERAL=n
CONFIG_BT_NIMBLE_ROLE_OBSERVER=y
CONFIG_BT_NIMBLE_ROLE_BROADCASTER=n

# Only need 1 connection (to the scale)
CONFIG_BT_NIMBLE_MAX_CONNECTIONS=1

# Debug logging - change to 0 once working
CONFIG_BT_NIMBLE_LOG_LEVEL=1

# GATT client
CONFIG_BT_NIMBLE_GATTC_ENABLED=y

# Flash size
CONFIG_ESPTOOLPY_FLASHSIZE_4MB=y

# Use single-factory partition table (no OTA) to fit BLE+WiFi+HTTP
CONFIG_PARTITION_TABLE_SINGLE_APP_LARGE=y

# WiFi
CONFIG_ESP_WIFI_ENABLED=y
```
